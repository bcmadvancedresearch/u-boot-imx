## board/freescale/imx8mq_ar8mxm/Kconfig
```kconfig
if TARGET_IMX8MQ_AR8MXM || TARGET_IMX8MQ_AR8MXM_4GB

config SYS_BOARD
	default "imx8mq_ar8mxm"

config SYS_VENDOR
	default "freescale"

config SYS_CONFIG_NAME
	default "imx8mq_ar8mxm"

source "board/freescale/common/Kconfig"

endif
```

## configs/ar6mx_defconfig
```kconfig
CONFIG_TARGET_BCM_AR6MX=y
CONFIG_ARM=y
CONFIG_ARCH_MX6=y
CONFIG_SPL=y
CONFIG_SYS_EXTRA_OPTIONS="IMX_CONFIG=arch/arm/imx-common/spl_sd.cfg,MX6QDL"
CONFIG_SYS_PROMPT="AR6MX > "
```

## configs/ar6mxandroid_defconfig
```kconfig
CONFIG_SPL=y
CONFIG_SYS_EXTRA_OPTIONS="IMX_CONFIG=arch/arm/imx-common/spl_sd.cfg,MX6QDL,ANDROID_SUPPORT"
CONFIG_TARGET_BCM_AR6MX=y
CONFIG_ARM=y
CONFIG_SYS_PROMPT="AR6MX > "
CONFIG_DM=y
CONFIG_DM_THERMAL=y
```

## configs/ar6mxcs_defconfig
```kconfig
CONFIG_SPL=y
CONFIG_SYS_EXTRA_OPTIONS="IMX_CONFIG=arch/arm/imx-common/spl_sd.cfg,MX6QDL"
CONFIG_ARM=y
CONFIG_TARGET_BCM_AR6MXCS=y
CONFIG_ARCH_MX6=y
CONFIG_SYS_PROMPT="AR6MXCS > "
```

## configs/ar6mxsandroid_defconfig
```kconfig
CONFIG_SYS_EXTRA_OPTIONS="IMX_CONFIG=board/bcm/ar6mx/ar6mxs.cfg,MX6QDL,ANDROID_SUPPORT"
CONFIG_ARM=y
CONFIG_TARGET_BCM_AR6MX=y
CONFIG_SYS_MALLOC_F=y
CONFIG_SYS_MALLOC_F_LEN=0x400
CONFIG_DM=y
CONFIG_DM_THERMAL=y
```

## configs/bh6mxqandroid_defconfig
```kconfig
CONFIG_TARGET_BCM_BH6MX=y
CONFIG_ARM=y
CONFIG_ARCH_MX6=y
CONFIG_SYS_EXTRA_OPTIONS="IMX_CONFIG=board/bcm/ar6mx/bh6mxq.cfg,MX6QDL,ANDROID_SUPPORT"
CONFIG_SYS_PROMPT="BH6MX > "
CONFIG_EFI_PARTITION=y
CONFIG_BOOTDELAY=3
CONFIG_HUSH_PARSER=y
CONFIG_SYS_CONSOLE_IS_IN_ENV=y
CONFIG_SYS_CONSOLE_OVERWRITE_ROUTINE=y

CONFIG_CMD_USB=y
CONFIG_CMD_DFU=y
CONFIG_CMD_I2C=y
CONFIG_DFU_MMC=y
CONFIG_DFU_SF=y
CONFIG_USB=y
CONFIG_USB_STORAGE=y

CONFIG_DEFAULT_DEVICE_TREE="imx6q-ar6mx"
CONFIG_OF_CONTROL=y
# CONFIG_BLK is not set
CONFIG_PINCTRL=y
CONFIG_PINCTRL_IMX6=y
CONFIG_DM_PMIC=y
CONFIG_DM_REGULATOR=y
CONFIG_DM_REGULATOR_FIXED=y
CONFIG_DM_GPIO=y
CONFIG_DM_I2C=y
CONFIG_DM_MMC=y
# CONFIG_DM_MMC_OPS is not set
CONFIG_DM_USB=y
```

## configs/mx6qgr60mxd_defconfig
```kconfig
CONFIG_SYS_EXTRA_OPTIONS="IMX_CONFIG=board/freescale/mx6qgr60mxd/imximage.cfg,MX6Q"
CONFIG_ARM=y
CONFIG_TARGET_MX6QGR60MXD=y
CONFIG_DM=y
CONFIG_DM_THERMAL=y
```

## configs/mx6qgr60mxdandroid_defconfig
```kconfig
CONFIG_SYS_EXTRA_OPTIONS="IMX_CONFIG=board/freescale/mx6qgr60mxd/imximage.cfg,MX6Q,ANDROID_SUPPORT"
CONFIG_ARM=y
CONFIG_TARGET_MX6QGR60MXD=y
CONFIG_SYS_MALLOC_F=y
CONFIG_SYS_MALLOC_F_LEN=0x400
CONFIG_DM=y
CONFIG_DM_THERMAL=y
```
